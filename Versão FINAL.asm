LIST   P=PIC16F628A
RADIX DEC

#INCLUDE <P16F628A.INC>		;ARQUIVO PADRÃO MICROCHIP PARA 16F628A
__CONFIG H'3F10' 			;__CONFIG _INTRC_OSC_NOCLKOUT & _WDT_OFF & _PWRTE_ON & _BODEN_OFF & _LVP_OFF & _CP_OFF & _MCLRE_OFF & _DATA_CP_OFF

#DEFINE	BANK0	BCF STATUS,RP0	;SETA BANK 0 DE MEMÓRIA
#DEFINE	BANK1	BSF STATUS,RP0	;SETA BANK 1 DE MAMÓRIA

#DEFINE	BOTAO		PORTA,2	;PORTA DO BOTÃO
					; 0 -> PRESSIONADO
					; 1 -> LIBERADO
#DEFINE	A_VERM		PORTB,0	; VERMELHO S1
					; 0 -> APAGADO
					; 1 -> ACESO
#DEFINE	A_AMAR		PORTB,1	; AMARELO S1
					; 0 -> APAGADO
					; 1 -> ACESO
#DEFINE	A_VERD		PORTB,2	; VERDE S1
					; 0 -> APAGADO
					; 1 -> ACESO
#DEFINE	B_VERM		PORTB,3	; VERMELHO S2
					; 0 -> APAGADO
					; 1 -> ACESO
#DEFINE	B_AMAR		PORTB,4	; AMARELO S2
					; 0 -> APAGADO
					; 1 -> ACESO
#DEFINE	B_VERD		PORTB,5	; VERDE S2
					; 0 -> APAGADO
					; 1 -> ACESO
#DEFINE	PED_PARA	PORTB,6	; PARA PEDESTRE
					; 0 -> APAGADO
					; 1 -> ACESO
#DEFINE	PED_VAI		PORTB,7	; VAI PEDESTRE
					; 0 -> APAGADO
					; 1 -> ACESO

	CBLOCK	0x20	;ENDEREÇO INICIAL DA MEMÓRIA DE USUÁRIO

	CONTADOR1
	CONTADOR2
	CONTADOR3
	CONTADOR4
	CONTADOR5

	FLAGAA		; FLAG SINAL_A AMARELO
	FLAGAB		; FLAG SINAL_B AMARELO

	ENDC			;FIM DO BLOCO DE MEMÓRIA

	ORG	0x00		;ENDEREÇO INICIAL DE PROCESSAMENTO
	GOTO	INICIO

INICIO
	CLRF	PORTA		;LIMPA O PORTA
	CLRF	PORTB		;LIMPA O PORTB
	BANK1			;ALTERA PARA O BANCO 1
	MOVLW	B'00000100'
	MOVWF	TRISA		;DEFINE RA2 COMO ENTRADA E DEMAIS COMO SAÍDAS
	MOVLW	B'00000000'
	MOVWF	TRISB		;DEFINE TODO O PORTB COMO SAÍDA
	MOVLW	B'00000000'
	MOVWF	INTCON		;TODAS AS INTERRUPÇÕES DESLIGADAS
	BANK0			;RETORNA PARA O BANCO 0
	MOVLW	B'00000111'
	MOVWF	CMCON		;DEFINE O MODO DO COMPARADOR ANALÓGICO

MAIN
	CLRF PORTB
	
	MOVLW	-1
	MOVWF	FLAGAA
	
	MOVLW	-1			; ATRIBUI 8 AO CONTADOR 3
	MOVWF	FLAGAB
	
	BSF A_VERD
	BSF B_VERM
	BSF PED_PARA
	CALL LOOP1		; A = VERDE		B = VERMELHO
	CALL LOOP1
	CALL LOOP1
	CALL LOOP1
	CALL LOOP1

	BCF A_VERD	
	BSF	A_AMAR	; A = AMARELO		B = VERMELHO
	CALL LOOP1
	CALL LOOP1
	
	GOTO TESTAFLAGS1; TESTA SE O SINAL A ESTÁ EM AMARELO

VOLTA_MAIN

	CLRF PORTB
	BSF	A_VERM
	BSF B_VERD
	BSF PED_PARA  ; A = VERMELHO	B = VERDE
	CALL LOOP1

	BCF B_VERD
	BSF B_AMAR	; A = VERMELHO		B = AMARELO
	;------------------------------------------------------- aqui 
	CALL LOOP1
	CALL LOOP1
	
	GOTO TESTAFLAGS2; TESTA SE O SINAL B ESTÁ EM AMARELO


ACIONA_PED

	BTFSC A_VERD  ; IF(A_VERD==0) PULA A PROXIMA LINHA
	GOTO AVERDE

	BTFSC A_AMAR  ; IF(A_AMAR==0) PULA A PROXIMA LINHA
	GOTO AAMARELO; 

	BTFSC A_VERM  ; IF(A_VERM==0) PULA A PROXIMA LINHA
	GOTO TESTAB   ; A = VERMELHO	B = ?

	TESTAB
		BTFSC B_VERD  ; IF(B_VERD==0) PULA A PROXIMA LINHA
		GOTO BVERDE

		BTFSC B_AMAR  ; IF(B_AMAR==0) PULA A PROXIMA LINHA
		GOTO BAMARELO; 
		GOTO BVERMELHO; 
 
	AVERDE; SINAL A = VERDE		SINAL B = VERMELHO
		BCF  A_VERD
		BSF	 A_AMAR
		CALL LOOP1
		CALL LOOP1
		BCF	 A_AMAR
		BSF	 A_VERM

		BCF  PED_PARA
		BSF  PED_VAI;;;;;;;;; PASSAGEM PEDESTRE
		CALL LOOP1
		CALL LOOP1
		CALL LOOP1
		GOTO INVERTE

	AAMARELO; SINAL A = AMARELO		SINAL B = VERMELHO
		MOVLW	1
		MOVWF	FLAGAA  ; FLAG SINAL_A EM AMARELO = 1
		GOTO CONTINUA

	
	BVERDE; SINAL A = VERMELHO		SINAL B = VERDE
		BCF B_VERD
		BSF B_AMAR
		CALL LOOP1
		CALL LOOP1
		BCF B_AMAR
		BSF B_VERM
	
		BCF  PED_PARA
		BSF  PED_VAI;;;;;;;;; PASSAGEM PEDESTRE
		CALL LOOP1
		CALL LOOP1
		CALL LOOP1
		GOTO INVERTE

	BAMARELO; SINAL A = VERMELHO		SINAL B = AMARELO
		MOVLW	1
		MOVWF	FLAGAB  ; FLAG SINAL_B EM AMARELO = 1
		GOTO CONTINUA

	BVERMELHO; SINAL A = VERMELHO 	SINAL  B = VERMELHO
		BCF  PED_PARA
		BSF  PED_VAI;;;;;;;;; PASSAGEM PEDESTRE
		CALL LOOP1
		CALL LOOP1
		CALL LOOP1
		GOTO INVERTE
		
	TESTAFLAGS1
		DECFSZ	FLAGAA ; FLAG SINAL_A EM AMARELO = 1
		GOTO VOLTA_MAIN ; FLAGAA != 0 -> CONTINUA ROTINA NORMAL NO MAIN 
		GOTO SETA_FLAGAA	; FLAGAA = 0

	TESTAFLAGS2
		DECFSZ	FLAGAB
		GOTO MAIN ; FLAGAA != 0-------RETORNA LOOP 
		GOTO SETA_FLAGAB	; FLAGAA = 0 ------NAO, CONTINUA


SETA_FLAGAA	; SINAL_A: AMARELO->VERMELHO E DEPOIS INVERTE
	BCF A_AMAR
	BSF A_VERM		; A = VERMELHO		B = VERMELHO
	BCF PED_PARA
	BSF PED_VAI;;;;;;;;; PASSAGEM PEDESTRE
	MOVLW -1
	MOVWF FLAGAA
	CALL LOOP1
	CALL LOOP1
	CALL LOOP1
	GOTO INVERTE

SETA_FLAGAB ; SINAL_B: AMARELO->VERMELHO E DEPOIS INVERTE
	BCF B_AMAR
	BSF B_VERM		; A = VERMELHO		B = VERMELHO
	BCF PED_PARA
	BSF PED_VAI;;;;;;;;; PASSAGEM PEDESTRE
	MOVLW -1
	MOVWF FLAGAA
	CALL LOOP1
	CALL LOOP1
	CALL LOOP1
	GOTO INVERTE
 
INVERTE
	CLRF PORTB
	BSF	 A_VERD		;SINAL A = VERDE		SINAL B = VERMELHO
	BSF	 B_VERM
	BSF	 PED_PARA
	CALL LOOP1
	CALL LOOP1
	CALL LOOP1

	BCF  A_VERD
	BSF	 A_AMAR		;SINAL A = AMARELO		SINAL B = VERMELHO
	CALL LOOP1
	CALL LOOP1

	BCF	 A_AMAR
	BSF	 A_VERM		
	BCF  B_VERM
	BSF  B_VERD		;SINAL A = VERMELHO		SINAL B = VERDE
	CALL LOOP1
	CALL LOOP1
	CALL LOOP1
	BCF  B_VERD
	BSF  B_AMAR		;SINAL A = VERMELHO		SINAL B = AMARELO
	CALL LOOP1
	CALL LOOP1

	GOTO MAIN

BOTAO_PRES1
	DECFSZ	CONTADOR5	; CONTADOR5 USADO NO DEBOUCING
	GOTO	CONTINUA	; CONTADOR5 != 0 
	GOTO	ACIONA_PED  ; CONTADOR5 = 0 

LOOP1
NOP
NOP
NOP
NOP
NOP

	MOVLW	0
	MOVWF	CONTADOR1
	MOVLW	0
	MOVWF	CONTADOR2
	MOVLW	0
	MOVWF	CONTADOR3
	MOVLW	0
	MOVWF	CONTADOR4
	MOVLW	0
	MOVWF	CONTADOR5

	MOVLW	8
	MOVWF	CONTADOR3
	CALL 	LOOP2
	RETURN

LOOP2
NOP
NOP
NOP
NOP
NOP
NOP
NOP
	MOVLW	10
	MOVWF	CONTADOR1
	MOVLW	5
	MOVWF	CONTADOR5	; CONTADOR PARA TESTAR DEBOUCING
	CALL	LOOP3
	DECFSZ	CONTADOR3
	GOTO    LOOP2
	RETURN

LOOP3
	NOP  ; ATÉ CHEGAR NESSE PONTO DE NOVO DEMORA 12,5 MS
	BTFSC	BOTAO   ;O BOTÃO ESTÁ PRESSIONADO? 0: PRESSIONADO  1: LIBERADO
	GOTO REINICIA_CONT5	; NAO, CONTINUA
	GOTO BOTAO_PRES1 ; SIM, ENTRA NO TESTE BOTAO_PRES1
	; O TESTE DO BOTÃO DEMORA 12,5 MS
	; COMO O DEBOUNCIG DEVE SER NO MÍNIMO 30 MS, USAMOS CONTADOR5
	; CONTADOR5 = 5 - 1 = 4 (12,5MS)
	; CONTADOR5 = 4 - 1 = 3 (25MS)
	; CONTADOR5 = 3 - 1 = 2 (37,5MS)
	; CONTADOR5 = 2 - 1 = 1 (50MS)
	; CONTADOR5 = 1 - 1 = 0 ----> TESTOU O BOTÃO: ACIONA OU NÃO O SINAL DE PEDESTRE

REINICIA_CONT5
	MOVLW 5
	MOVWF CONTADOR5
	
CONTINUA
NOP
NOP
NOP
NOP
	MOVLW	40
	MOVWF	CONTADOR2
	CALL	LOOP4
	DECFSZ	CONTADOR1
	GOTO    LOOP3
	RETURN

LOOP4
NOP
NOP
NOP
NOP
	MOVLW	100
	MOVWF	CONTADOR4
	CALL	LOOP5
	DECFSZ	CONTADOR2
	GOTO	LOOP4
	RETURN

LOOP5
	DECFSZ	CONTADOR4
	GOTO	LOOP5
	RETURN

	END			;OBRIGATÓRIO